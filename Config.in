## Config.in
```kconfig
source "$BR2_EXTERNAL_bragov4ik_kernel_mod_PATH/package/bragov4ik/Config.in"
source "$BR2_EXTERNAL_bragov4ik_kernel_mod_PATH/package/module_test/Config.in"
```

## package/bragov4ik/Config.in
```kconfig
config BR2_PACKAGE_BRAGOV4IK
        bool "bragov4ik"
        help
	  This package contains kernel module(-s) for advanced linux course.
```

## package/module_test/Config.in
```kconfig
config BR2_PACKAGE_MODULE_TEST
        bool "module_test"
        help
	  This package contains test(-s) for kernel module(-s) for advanced linux course.
```
